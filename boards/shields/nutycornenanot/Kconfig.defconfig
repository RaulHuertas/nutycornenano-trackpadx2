## boards/shields/nutycornenanot/Kconfig.defconfig
```kconfig
if SHIELD_NUTYCORNENANOT_LEFT

# Name must be less than 16 characters long!
config ZMK_KEYBOARD_NAME
    default "NutyCorneNanoT"
config ZMK_POINTING
    default y
config ZMK_POINTING_SMOOTH_SCROLLING
    default y
config ZMK_SPLIT_ROLE_CENTRAL
    default y

endif


if SHIELD_NUTYCORNENANOT_RIGHT
# Name must be less than 16 characters long!
config ZMK_KEYBOARD_NAME
    default "NutyCorneNanoT"
config ZMK_POINTING
    default y
config I2C
    default y
config ZMK_POINTING_SMOOTH_SCROLLING
    default y

endif


if SHIELD_NUTYCORNENANOT_LEFT || SHIELD_NUTYCORNENANOT_RIGHT

config ZMK_SPLIT
    default y

endif



if SHIELD_NUTYCORNENANOT_DONGLE

# Max 16 characters in keyboard name
config ZMK_KEYBOARD_NAME
    default "NutyCorneNanoT"

config ZMK_POINTING
    default y
config ZMK_POINTING_SMOOTH_SCROLLING
    default y

config ZMK_SPLIT_ROLE_CENTRAL
    default y

config ZMK_SPLIT
    default y

# Set this to the number of peripherals your dongle will have.
# For a unibody, this would be 1. If you have left and right halves, set it to 2, etc.
config ZMK_SPLIT_BLE_CENTRAL_PERIPHERALS
    default 2

# Set this to ZMK_SPLIT_BLE_CENTRAL_PERIPHERALS + your desired number of BT profiles (default is 5)
config BT_MAX_CONN
    default 7

# Set this to the same number as BT_MAX_CONN
config BT_MAX_PAIRED
    default 7

endif
```

## boards/shields/nutycornenanot/Kconfig.shield
```kconfig
# No whitespace after the comma or in your part name!
config SHIELD_NUTYCORNENANOT_LEFT
    def_bool $(shields_list_contains,nutycornenanot_left)

# No whitespace after the comma or in your part name!
config SHIELD_NUTYCORNENANOT_RIGHT
    def_bool $(shields_list_contains,nutycornenanot_right)

# No whitespace after the comma or in your part name!
config SHIELD_NUTYCORNENANOT_DONGLE
    def_bool $(shields_list_contains,nutycornenanot_dongle)
```

## config/west.yml
```yaml
manifest:
  defaults:
    revision: v0.3
  remotes:
    - name: zmkfirmware
      url-base: https://github.com/zmkfirmware
    # Additional modules containing boards/shields/custom code can be listed here as well
    # See https://docs.zephyrproject.org/3.2.0/develop/west/manifest.html#projects
    - name: RaulHuertas
      url-base: https://github.com/RaulHuertas
  projects:
    - name: zmk
      remote: zmkfirmware
      revision: v0.3.0
      import: app/west.yml
    - name: cirque-input-module
      remote: RaulHuertas
      revision: main
    - name: zmk-rgbled-widget  # <-- new entry
      remote: RaulHuertas
      revision: v0.3           # MUST match your ZMK version!
  self:
    path: config
```
